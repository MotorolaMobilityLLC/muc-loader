## configs/hdk/eeprom/defconfig
```kconfig
CONFIG_DEBUG=y
# CONFIG_RUN_FROM_FLASH is not set
CONFIG_MOD_TYPE=hdk
CONFIG_ARCH_BOARDID_PID=0x00010403
CONFIG_ARCH_BOARDID_VID=0x00000312
CONFIG_ARCH_UNIPRO_PID=0x00006415
CONFIG_ARCH_UNIPRO_MFG=0x00000104
CONFIG_ROOT_VERSION=3
CONFIG_SPIN_WHILE_DETACHED=y
# CONFIG_NO_FLASH is not set
CONFIG_CHIPSET=STM32L4xx
CONFIG_CHIPSET_LC=stm32l4xx
CONFIG_TARGET_DEVICE=STM32L476xx
CONFIG_TARGET_DEVICE_LC=stm32l476xx
CONFIG_BOARD=STM32L476G-Discovery
CONFIG_CUBE_DIR=STM32Cube_FW_L4_V1.0.0
CONFIG_ARCH_HAS_HW_FLOAT=y
CONFIG_APBE_FLASH=y
# CONFIG_DEBUG_SPI_FLASH is not set
CONFIG_VALIDATE_VID=y
CONFIG_VALIDATE_PID=y
CONFIG_MOD_SIGNATURE_VALIDATION=y
# CONFIG_DEBUG_DATALINK is not set
# CONFIG_DEBUG_FIRMWARE is not set
CONFIG_DATALINK_SPI=y
CONFIG_GREYBUS_MODS_ACK=y
# CONFIG_DATALINK_I2C is not set
# CONFIG_GPIO_PORT_FORCE_FLASH is not set
# CONFIG_GPIO_PIN_FORCE_FLASH is not set
CONFIG_RAMLOG=y
CONFIG_RAMLOG_ADDR=0x20017000
# CONFIG_EEPROM_PROGRAMMING is not set
CONFIG_EEPROM_IDS=y
# CONFIG_EEPROM128 is not set
# CONFIG_EEPROM_PROGRAMMING_ERASE_IDS is not set
CONFIG_GREYBUS_MODS_SUPPORT_VENDOR_UPDATES=y
```

## configs/hdk/p0/defconfig
```kconfig
CONFIG_DEBUG=y
CONFIG_MOD_TYPE=hdk
CONFIG_ARCH_BOARDID_PID=0x00010000
CONFIG_ARCH_BOARDID_VID=0x00000128
CONFIG_ROOT_VERSION=0
CONFIG_NO_FLASH=y
```

## configs/hdk/p1/defconfig
```kconfig
CONFIG_DEBUG=y
CONFIG_MOD_TYPE=hdk
CONFIG_ARCH_BOARDID_PID=0x00010001
CONFIG_ARCH_BOARDID_VID=0x00000128
CONFIG_ROOT_VERSION=2
# CONFIG_NO_FLASH is not set
CONFIG_CHIPSET=STM32L4xx
CONFIG_CHIPSET_LC=stm32l4xx
CONFIG_TARGET_DEVICE=STM32L476xx
CONFIG_TARGET_DEVICE_LC=stm32l476xx
CONFIG_BOARD=STM32L476G-Discovery
CONFIG_CUBE_DIR=STM32Cube_FW_L4_V1.0.0
CONFIG_ARCH_HAS_HW_FLOAT=y
```
